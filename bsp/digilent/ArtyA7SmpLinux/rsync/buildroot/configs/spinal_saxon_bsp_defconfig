## bsp/digilent/ArtyA7SmpLinux/rsync/buildroot/configs/spinal_saxon_bsp_defconfig
```kconfig
# Compilation cache
BR2_CCACHE=y
BR2_CCACHE_DIR="$(HOME)/.buildroot-ccache-saxon_default"

# Target options
BR2_riscv=y
BR2_RISCV_32=y

# Instruction Set Extensions
BR2_riscv_custom=y
BR2_RISCV_ISA_CUSTOM_RVM=y
BR2_RISCV_ISA_CUSTOM_RVA=y
BR2_RISCV_ISA_CUSTOM_RVC=n
BR2_RISCV_ABI_ILP32=y

# GCC
BR2_GCC_VERSION_8_X=y

# System
BR2_TARGET_GENERIC_GETTY=y
BR2_TARGET_GENERIC_GETTY_PORT="hvc0"
BR2_USE_WCHAR=y

# Filesystem
BR2_TARGET_ROOTFS_CPIO=y

# Net
BR2_SYSTEM_DHCP="eth0"

# Linux headers
BR2_PACKAGE_HOST_LINUX_HEADERS_CUSTOM_5_0=y

# Kernel
BR2_LINUX_KERNEL=y
BR2_LINUX_KERNEL_LATEST_VERSION=n
BR2_LINUX_KERNEL_CUSTOM_VERSION=y
BR2_LINUX_KERNEL_CUSTOM_VERSION_VALUE="5.0.9"
BR2_LINUX_KERNEL_USE_CUSTOM_CONFIG=y
BR2_LINUX_KERNEL_CUSTOM_CONFIG_FILE="board/spinal/saxon_bsp/linux.config"
BR2_LINUX_KERNEL_VMLINUX=y

# Rootfs customisation
BR2_ROOTFS_OVERLAY="board/spinal/saxon_bsp/rootfs_overlay"

# U-BOOT
BR2_PACKAGE_HOST_UBOOT_TOOLS=y
BR2_TARGET_ROOTFS_CPIO_UIMAGE=y

# Flashing
BR2_PACKAGE_MTD=y
BR2_PACKAGE_MTD_FLASH_ERASE=y
BR2_PACKAGE_MTD_TESTS=y
BR2_PACKAGE_MTD_FLASH_SPEED=y
BR2_PACKAGE_MTD_FLASH_TORTURE=y

# Extra packages
BR2_PACKAGE_UTIL_LINUX_LSBLK=y
BR2_PACKAGE_DHRYSTONE=y
BR2_PACKAGE_MICROPYTHON=n
BR2_PACKAGE_PYTHON=n
BR2_PACKAGE_PYTHON_SPIDEV=n
BR2_PACKAGE_SL=y
BR2_PACKAGE_HELLO=n
BR2_PACKAGE_NANO=y

BR2_PACKAGE_LMBENCH=n
BR2_PACKAGE_RAMSPEED=n
BR2_PACKAGE_STRESS_NG=n

BR2_GCC_CROSS_CXX=y
BR2_INSTALL_LIBSTDCPP=y
BR2_PACKAGE_IPERF=y
BR2_PACKAGE_IPERF3=y

BR2_PACKAGE_HTOP=y
BR2_PACKAGE_LYNX=n
BR2_PACKAGE_LINKS=n

#BR2_PACKAGE_RNG_TOOLS=y
#BR2_PACKAGE_HAVEGED=y

#BR2_PACKAGE_LIBATOMIC_OPS_ARCH_SUPPORTS=y
#BR2_PACKAGE_LIBATOMIC_OPS=y
#BR2_PACKAGE_OPENSSL=y
#BR2_PACKAGE_LIBOPENSSL=y
#BR2_PACKAGE_LIBOPENSSL_BIN=y
#BR2_PACKAGE_OPENSSH=y
#BR2_ROOTFS_DEVICE_TABLE="board/spinal/saxon_bsp/permissions.txt"

#BR2_PACKAGE_GNUTLS=y

BR2_PACKAGE_DROPBEAR=y

BR2_PACKAGE_SSHPASS=y

#BR2_PACKAGE_BUSYBOX_SHOW_OTHERS=y
#BR2_PACKAGE_BASH=y

#BR2_PACKAGE_GIT=y

BR2_TOOLCHAIN_BUILDROOT_CXX=y


BR2_PACKAGE_FB_TEST_APP=y

# Using SDL_FBCON
BR2_PACKAGE_SDL=y
BR2_PACKAGE_SDL_FBCON=y

# Using DirectFB
#BR2_PACKAGE_DIRECTFB=y
#BR2_PACKAGE_DIRECTFB_TESTS=y
#BR2_PACKAGE_DIRECTFB_EXAMPLES=y
#BR2_PACKAGE_SDL2_DIRECTFB=y

# Using X11
#BR2_PACKAGE_SDL2_X11=y
#BR2_PACKAGE_XORG7=y
#BR2_PACKAGE_XDRIVER_XF86_INPUT_KEYBOARD=y
#BR2_PACKAGE_XDRIVER_XF86_INPUT_MOUSE=y
#BR2_PACKAGE_XDRIVER_XF86_VIDEO_FBDEV=y
#BR2_PACKAGE_XAPP_TWM=y
#BR2_PACKAGE_XAPP_XCALC=y
#BR2_PACKAGE_XAPP_XCLOCK=y
#BR2_PACKAGE_XAPP_XEYES=y
#BR2_PACKAGE_XAPP_XINIT=y
#BR2_PACKAGE_XSERVER_XORG_SERVER=y
#BR2_PACKAGE_XTERM=y
#BR2_TOOLCHAIN_BUILDROOT_WCHAR=y

#BR2_PACKAGE_XDOTOOL=y
#BR2_PACKAGE_XAPP_XWININFO=y
#BR2_PACKAGE_XAPP_XDPYINFO=y
#BR2_PACKAGE_XAPP_BITMAP=n
#BR2_PACKAGE_XAPP_X11PERF=n
#BR2_PACKAGE_XAPP_BEFORELIGHT=n


# Sound
BR2_PACKAGE_ALSA_UTILS=y
BR2_PACKAGE_ALSA_UTILS_APLAY=y
BR2_PACKAGE_ALSA_UTILS_AMIXER=y
BR2_PACKAGE_ALSA_UTILS_ALSACONF=y
BR2_PACKAGE_ALSA_UTILS_SPEAKER_TEST=y
BR2_PACKAGE_ALSA_UTILS_ALSACTL=y
BR2_PACKAGE_ALSA_UTILS_BAT=y
BR2_PACKAGE_ALSA_LIB=y
BR2_PACKAGE_ALSA_LIB_PCM_PLUGINS=y

# Sound decoders
BR2_PACKAGE_MPG123=y
BR2_PACKAGE_MPV=n
BR2_PACKAGE_FFMPEG_FFPLAY=n

# I2C
BR2_PACKAGE_BUSYBOX_SHOW_OTHERS=y
BR2_PACKAGE_I2C_TOOLS=y
```

## bsp/digilent/ArtyA7SmpLinux/rsync/u-boot/configs/saxon_bsp_defconfig
```kconfig
CONFIG_RISCV=y
CONFIG_SMP=y
CONFIG_NR_CPUS=4
CONFIG_SBI_V01=y
CONFIG_SYS_TEXT_BASE=0x80F00000
CONFIG_NR_DRAM_BANKS=1
CONFIG_SPL=n
CONFIG_DEBUG_UART_BASE=0x10010000
CONFIG_DEBUG_UART_CLOCK=100000000
CONFIG_DEBUG_UART=y
CONFIG_TARGET_VEXRISCV_SAXON=y
CONFIG_SPL_TEXT_BASE=0x81F00000
CONFIG_RISCV_SMODE=y
CONFIG_SPL_RISCV_SMODE=y
# CONFIG_RISCV_ISA_C is not set
CONFIG_EXTRA_ENV_SETTINGS="miaou"
CONFIG_DISTRO_DEFAULTS=y
CONFIG_BOOTDELAY=2
CONFIG_BOOTCOMMAND="load mmc 0:1 0x80000000 uImage;load mmc 0:1 0x80FF0000 dtb;bootm 0x80000000 - 0x80FF0000"
#CONFIG_BOOTDELAY=0
#CONFIG_BOOTCOMMAND="bootm 0x80000000 0x80FFFFC0 0x80FF0000"
CONFIG_SPL_OS_BOOT=y
CONFIG_SPL_PAYLOAD=""
CONFIG_SPL_RAM_SUPPORT=y
CONFIG_SPL_RAM_DEVICE=y
CONFIG_CMD_MMC=y
CONFIG_CMD_SPI=y
CONFIG_CMD_TIMER=y
CONFIG_PARTITIONS=y
CONFIG_BLK=y
CONFIG_OF_EMBED=y
CONFIG_DEFAULT_DEVICE_TREE="saxon_bsp"
CONFIG_MMC=y
CONFIG_MMC_BROKEN_CD=y
CONFIG_MMC_SPI=y
CONFIG_MMC_SPI_CRC_ON=y
CONFIG_RISCV_SBI_SERIAL=y
CONFIG_DEBUG_UART_RISCV_SBI=y
CONFIG_SPI=y
CONFIG_VEXRISCV_SPI=y
CONFIG_RISCV_TIMER=y
CONFIG_MMC_TRACE=n
CONFIG_FS_EXT4=y
CONFIG_SYS_MALLOC_F_LEN=0x8000

CONFIG_CMD_EXT4_WRITE=y
CONFIG_CMD_FAT=y
CONFIG_FAT_WRITE=y

# ENV in SDCARD
CONFIG_ENV_IS_IN_FAT=y
CONFIG_ENV_FAT_INTERFACE="mmc"
CONFIG_ENV_FAT_DEVICE_AND_PART="0:1"
CONFIG_ENV_FAT_FILE="/uboot.env"
```
